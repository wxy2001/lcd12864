#include <IAP15W4K61S4.h>
#include <stdio.h>
#define uint  unsigned int
typedef unsigned char uChar8;

/**************************************定义全局变量***********************************************************************/	

uChar8 code start[] =  //开始界面
{
0x00,0x00,0x00,0x00,0x00,0x00,0x00,0x00,0x00,0x00,0x00,0x00,0x00,0x00,0x00,0x00,
0x00,0x00,0x00,0x00,0x00,0x00,0x00,0x00,0x00,0x00,0x00,0x00,0x00,0x00,0x00,0x00,
0x00,0x00,0x00,0x00,0x00,0x00,0x00,0x00,0x00,0x00,0x00,0x00,0x00,0x00,0x00,0x00,
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0x00,0x00,0x00,0x00,0x00,0x00,0x00,0x00,0x00,0x00,0x00,0x00,0x00,0x00,0x00,0x00,
};

/**************************************定义外部函数接口************************************************************************/
extern void LCD12864ShowString(uChar8 x, uChar8 y, uChar8* str);  //显示字符串
extern void LCD12864WriteCommand(uChar8 command);	                //写命令函数
extern void initLCD12864(void);	                                //初始化12864
extern void LCD12864WriteData(uChar8 dat);
extern void img_disp(uChar8 code *img);  //画像素图
extern void img_clear(void);             //清屏
extern void img_line_start1(void);       //画下“开始”处的下划线
extern void img_underLine(uChar8 k);     //游戏界面下划线管理
extern int time;                         //时间
extern void BMP_disp(uChar8 x, uChar8 y, uChar8 code *img);
extern void keyDriver(void); 
extern void LCD12864ShowString(uChar8 x, uChar8 y, uChar8* str); //第y行第x列，开始打印str
extern void LCD12864EraseArea(uChar8 x, uChar8 y, uChar8 size);  //从第y行第x列开始，删除size字
extern uChar8 interface;

/**************************************函数声明*******************************************************************************/
void startInterface(void);               //开始界面
void gameInterface(void);                //游戏界面
void studentInterface(void);             //信息界面
uChar8 judge(int x, int y, int id);
void update(uChar8 a, uChar8 b);
void fun(uChar8 key, uChar8 dirction);
void R_right(void);
void R_left(void);
void R_down(void);
void R_up(void);
void show_hanzi(void);


int cur_x, cur_y, X, dir[4][2] = { -1,0,1,0,0,-1,0,1 }, where[3][2] = { 4,6,5,6,6,6 };


uChar8 code table1[] = "LCD12864";
uChar8 code table2[] = "推箱子";
uChar8 code table3[] = "BY AP&Yu";

uChar8 index = 6;

uChar8 code tmp[] = {//空格
0xff,0xff,0xff,0xff,0xff,0xff,0xff,0xff
};
/* 0表示空格，1表示墙，2表示人，3表示箱子，4表示目的地 */
uChar8 code mat[8][8] = {
1,1,1,1,1,1,1,1,
1,1,1,1,0,2,1,1,
1,1,0,0,3,0,1,1,
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1,1,1,1,1,1,1,1
};


uChar8 map[8][8];

uChar8 code Qiang[] = {//方格，有间隙
0xff,0x81,0x81,0x81,0x81,0x81,0x81,0xff
};

uChar8 code Ren[] = {//人
0xC3,0x81,0x24,0x00,0x24,0x3C,0x81,0xC3,
};

uChar8 code Xiang[] = {//箱子  
0xff,0x42,0x24,0x18,0x18,0x24,0x42,0xff
};

uChar8 code Mudi[] = {//目的地  
0xFF,0xE7,0xE7,0x81,0x81,0xE7,0xE7,0xFF,
};

void init_BMP()
{
	LCD12864WriteCommand(0x36);
	LCD12864WriteCommand(0x36);
	LCD12864WriteCommand(0x3E);
	LCD12864WriteCommand(0x01);
}

void display_BMP(uChar8 F, uChar8 name1, uChar8 name2, uChar8 y, uChar8 x)
{
	uChar8 S, i;
	if (F == 0)S = 0x80;
	else S = 0x88;
	for (i = 0; i < 8; i++)
	{
		LCD12864WriteCommand(0x80 + i + 8 * x);//先送垂直地址 
		LCD12864WriteCommand(S + y);  //再送水平地址 ----显示图片的上半部分 

		if (name1 == 0)LCD12864WriteData(tmp[i]);
		else if (name1 == 1)	LCD12864WriteData(Qiang[i]);
		else if (name1 == 2)	LCD12864WriteData(Ren[i]);
		else if (name1 == 3)	LCD12864WriteData(Xiang[i]);
		else if (name1 == 4)	LCD12864WriteData(Mudi[i]);

		if (name2 == 0)	LCD12864WriteData(tmp[i]);
		else if (name2 == 1)	LCD12864WriteData(Qiang[i]);
		else if (name2 == 2)	LCD12864WriteData(Ren[i]);
		else if (name2 == 3)	LCD12864WriteData(Xiang[i]);
		else if (name2 == 4)	LCD12864WriteData(Mudi[i]);
	}
}

void show_map() {
	uChar8 i, j, x, y;

	for (i = 0; i < 2; i++) {
		for (j = 0; j < 4; j++) {
			x = 2 * i; y = 2 * j;
			display_BMP(0, map[x][y], map[x][y + 1], j, 2 * i);
			x = 2 * i + 1; y = 2 * j;
			display_BMP(0, map[x][y], map[x][y + 1], j, 2 * i + 1);
		}
	}

	for (i = 2; i < 4; i++) {
		for (j = 0; j < 4; j++) {
			x = 2 * i; y = 2 * j;
			display_BMP(1, map[x][y], map[x][y + 1], j, 2 * (i - 2));
			x = 2 * i + 1; y = 2 * j;
			display_BMP(1, map[x][y], map[x][y + 1], j, 2 * (i - 2) + 1);
		}
	}
	
	initLCD12864();
	LCD12864ShowString(4, 0, table1);
	LCD12864ShowString(4, 1, table2);
	LCD12864ShowString(4, 2, table3);



}

void show_hanzi(){
	LCD12864WriteCommand(0x34);      
	LCD12864WriteCommand(0x80 + 50);   
	LCD12864WriteCommand(0x80 + 7);    
	LCD12864WriteCommand(0x30);      
	LCD12864WriteData(0x00);  
	LCD12864WriteData(0x00);
	LCD12864WriteCommand(0x36); 
	LCD12864WriteCommand(0x30);
}

void lcd_init() {
	uChar8 i, j;

	init_BMP();

	cur_x = 1; cur_y = 5;
	X = 3;

	for (i = 0; i < 8; i++) {
		for (j = 0; j < 8; j++)map[i][j] = mat[i][j];
	}
}


uChar8 judge(int x, int y, int id) {							//id 表示方向数组的行标，0,1,2,3 分别表示上下左右
	int xx, yy, xxx, yyy;
	xx = x + dir[id][0]; 
	yy = y + dir[id][1];
	if (map[xx][yy] == 0 || map[xx][yy] == 4)return 1;			   //1表示前面是 空格 或者 目的地，就是可以直接移动
	else if (map[xx][yy] == 1)return 0;						   //0表示无法移动
	else if (map[xx][yy] == 3) {
		xxx = xx + dir[id][0]; yyy = yy + dir[id][1];
		if (map[xxx][yyy] == 1 || map[xxx][yyy] == 3)return 0;
		else if (map[xxx][yyy] == 0 || map[xxx][yyy] == 4)return 2; //2表示需要间接移动，先把前面的箱子移动一，再让人移动一
	}return 0;
}

void update(uChar8 a, uChar8 b) {
	uChar8 i, j, x, y;

	LCD12864WriteCommand(0x3E);//8位(CL=1)，扩充指令(RE=1)，绘图打开(G=1) 

	if (a < 4) {
		i = a / 2; j = b / 2;
		x = 2 * i; y = 2 * j;
		display_BMP(0, map[x][y], map[x][y + 1], j, 2 * i);
		x = 2 * i + 1; y = 2 * j;
		display_BMP(0, map[x][y], map[x][y + 1], j, 2 * i + 1);
		
	}
	else {
		i = a / 2; j = b / 2;
		x = 2 * i; y = 2 * j;
		display_BMP(1, map[x][y], map[x][y + 1], j, 2 * (i - 2));
		x = 2 * i + 1; y = 2 * j;
		display_BMP(1, map[x][y], map[x][y + 1], j, 2 * (i - 2) + 1);
	}
}

void fun(uChar8 key, uChar8 dirction) {
	uChar8 x, y;
	// 0表示空格，1表示墙，2表示人，3表示箱子，4表示目的地 
	if (key == 1) {//直接移动
		if (mat[cur_x][cur_y] == 4)map[cur_x][cur_y] = 4;
		else map[cur_x][cur_y] = 0;
		update(cur_x, cur_y);

		cur_x += dir[dirction][0]; cur_y += dir[dirction][1];
		map[cur_x][cur_y] = 2;
		update(cur_x, cur_y);

	}
	else if (key == 2) {//间接移动
		if (mat[cur_x][cur_y] == 4)map[cur_x][cur_y] = 4;
		else map[cur_x][cur_y] = 0;
		update(cur_x, cur_y);

		cur_x += dir[dirction][0]; cur_y += dir[dirction][1];
		map[cur_x][cur_y] = 2;
		update(cur_x, cur_y);

		x = cur_x + dir[dirction][0]; y = cur_y + dir[dirction][1];
		map[x][y] = 3;
		update(x, y);
	}
}

void startInterface(void)                //开始界面
{
	img_clear();	
	img_disp(start);
	img_line_start1();
	time = 50;
}

void R_up(){
	index = judge(cur_x, cur_y, 0);
	fun(index, 0);
}
void R_down(){
	index = judge(cur_x, cur_y, 1);
	fun(index, 1);
}
void R_left(){
	index = judge(cur_x, cur_y, 2);
	fun(index, 2);
}
void R_right(){
	index = judge(cur_x, cur_y, 3);
	fun(index, 3);
}



void gameInterface(void)                 //游戏界面
{	
	uChar8 i, num;
	uChar8 string[8];
	img_clear();
	IE2 |= 0x04; 
	lcd_init();
	show_map();	
	show_hanzi();
	   
	while (1) {
		num = 0;
		for (i = 0; i < 3; i++) {
			if (map[where[i][0]][where[0][1]] == 3)num++;
			else break;
		}
		if (num == X)goto WIN;
		keyDriver();
		
	}
WIN:
	//initLCD12864();
	LCD12864WriteCommand(0x38);
  LCD12864WriteCommand(0x0C);
  LCD12864WriteCommand(0x06);
	IE2 = 0x00;                  //关闭定时器2
	sprintf(string, "得分:%03d", time);
	LCD12864ShowString(4, 2, string);
	sprintf(string, "YOU WIN!", time);
	LCD12864ShowString(4, 3, string);	
	interface=2;
	while(1){
		keyDriver();
	}
	
}

void studentInterface(void)              //信息界面
{
	uChar8 tab1[] = "吴**";
	uChar8 tab2[] = "3**20520518**";
	uChar8 tab3[] = "朱**";
	uChar8 tab4[] = "3**20520518**";
	img_clear();                         //清屏
	LCD12864ShowString(0, 0, tab1);
	LCD12864ShowString(0, 1, tab2);
	LCD12864ShowString(0, 2, tab3);
	LCD12864ShowString(0, 3, tab4);
}




